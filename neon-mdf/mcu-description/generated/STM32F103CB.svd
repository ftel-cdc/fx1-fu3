# STM32F103CB register map
Vendor: STMicroelectronics
STM32F103CB medium-density MCU, Cortex-M3, 128 KB Flash and 20 KB SRAM.
Registers are 32-bit, read-write, reset 0x0 unless marked. A register's access mark holds for its fields unless they carry their own. Offsets are from the block's base; lines under a group give offsets from that group; [hi:lo] are bit positions; {n}, {i} and the like mark numbered series; 'fields as' and 'values as' point back to an identical list; <NAME> marks a mode.

## Memory map
0x40010800 GPIOA size 0x400 — GPIO port A
0x40010C00 GPIOB size 0x400 — GPIO port B
0x40011000 GPIOC size 0x400 — GPIO port C; STM32F103CB package only bonds a sub-tap of the batteries
0x40011400 GPIOD size 0x400 — GPIO port D; STM32F103CB package only bond PD0/PD1 (OSC_IN/OSC_OUT)
0x40013800 USART1 size 0x400 — USART1; default pins PA9 TX and PA10 RX
0x40021000 RCC size 0x400 — Reset and Clock Control
0x40022000 FLASH size 0x400 — Flash memory interface

## RCC — Reset and Clock Control
Base 0x40021000
0x00 CR reset 0x83 — Clock control register
0x04 CFGR — Clock configuration register
0x08 CIR — Clock interrupt register
0x0C APB2RSTR — APB2 peripheral reset register
0x10 APB1RSTR — APB1 peripheral reset register
0x14 AHBENR reset 0x14 — AHB peripheral clock enable register
0x18 APB2ENR — APB2 peripheral clock enable register
0x1C APB1ENR — APB1 peripheral clock enable register
0x20 BDCR — Backup domain control register
0x24 CSR reset 0xC000000 — Control/status register

## GPIOA — GPIO port A
Base 0x40010800
Same registers: GPIOB 0x40010C00, GPIOC 0x40011000, GPIOD 0x40011400
0x00 CRL reset 0x44444444 — Port configuration low register, pins 0..7
0x04 CRH reset 0x44444444 — Port configuration high register, pins 8..15
0x08 IDR ro — Port input data register; reset bits 15:0 are pin-dependent (RM0008: 0x0000 XXXX)
0x0C ODR — Port output data register
0x10 BSRR wo — Port bit set/reset register
0x14 BRR wo — Port bit reset register
0x18 LCKR — Port configuration lock register

## USART1 — USART1; default pins PA9 TX and PA10 RX
Base 0x40013800
0x00 SR reset 0xC0 — Status register
0x04 DR — Data register
0x08 BRR — Baud rate register
{0x8+4i} CR{i} (i=1..3) — Control register {i}
0x18 GTPR — Guard time and prescaler register

## FLASH — Flash memory interface
Base 0x40022000
0x00 ACR reset 0x30 — Flash access control register
0x04 KEYR wo — Flash key register
0x08 OPTKEYR wo — Flash option key register
0x0C SR — Flash status register
0x10 CR reset 0x80 — Flash control register
0x14 AR — Flash address register
0x1C OBR ro — Option byte register
0x20 WRPR ro reset 0xFFFFFFFF — Write protection register
