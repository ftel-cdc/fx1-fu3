# FX1 register map
Vendor: FTEL; File version: VP_FX1_V3.0_ISP_1.07
FX1 RISC-V trên VP_FX1_V3.0; ISP CSR v1.07. Map VP, chưa xác nhận map silicon. W1P=pulse, W1SC=self-clear; xem CSR trước khi ghi.
Registers are 32-bit, read-write, reset 0x0 unless marked. A register's access mark holds for its fields unless they carry their own. Offsets are from the block's base; lines under a group give offsets from that group; [hi:lo] are bit positions; {n}, {i} and the like mark numbered series; 'fields as' and 'values as' point back to an identical list; <NAME> marks a mode.

## Memory map
0x02000000 CLINT size 0xC000 — Theo fx1_memory_map.h: 2 hart, machine software/timer interrupt. Không phải PLIC IRQ.
0x0C000000 PLIC size 0x201008 — Theo BSP VP: ID 0 bỏ trống; ID 1..9; context n là hart n M-mode. Không khai nguồn 0 thành IRQ.
0x10000000 UART size 0x48 — PL011-like VP; IRQ 1. FE/PE/BE không được kích thích; không có modem IRQ. Reset null: nguồn không xác nhận.
0x10010000 SYS_DMA size 0x10F8 — 8 kênh, stride 0x100, aperture register 0x1100, FIFO 32 byte, max transfer 1023 byte. Reset không có nguồn: null.
0x10020000 SIM_CTRL size 0x8 — CHỈ VP, không dùng cho silicon.
0x10030000 I2C0 size 0x24 — Phần Host dùng trong drivers/camera/fx1_i2c.c, IRQ 9. Chưa khai toàn bộ register của IP I2C; không thay map bằng OpenTitan upstream.
0x11000000 ISP size 0x8C94 — ISP FX1 v1.07; đủ register/field từ sheet Flat Registers của CSR. Địa chỉ base theo BSP VP_FX1_V3.0; không thay thế xác nhận map silicon.
0x11030000 ETH size 0x800C — FTEL Ethernet MAC MAS v1.0.7; VP dev 3b36805 drivers/eth/eth_regs.h. Aligned 32-bit CSR only.
0x11040000 MIPI_CSI2 size 0xF8 — MIPI CSI-2 RX Controller (FTEL MAS v1.4 / HAS v1.2, CSR v1.4). Chỉ có khi VP bật --camera. Base là placeholder VP; 4 KiB aperture, giải mã 0x00-0xFF, 0x100-0xFFF trả DECERR. Lệch so với VP fx1_csi2_regs.h (workbook cũ): IP_VERSION, STREAM_CONFIG reset/bit2, BUFFER_STATUS bit19, DMA_ATTR reset, META_AREA_SIZE, TPG_CONTROL[5:4].

## Interrupts
1 UART
2 SYS_DMA
3 ISP
6 ETH
9 I2C0

## CLINT — Theo fx1_memory_map.h: 2 hart, machine software/timer interrupt. Không phải PLIC IRQ.
Base 0x02000000
0x00 MSIP_HART0 reset not defined — Machine software interrupt hart 0. [access=rw]
  [0] MSIP — [access=rw]
0x04 MSIP_HART1 reset not defined — Machine software interrupt hart 1. [access=rw]
  [0] MSIP — [access=rw]
0x4000 MTIMECMP_HART0_LO reset not defined — Word LO của mtimecmp hart 0; dùng trình tự RV32 an toàn trong BSP. [access=rw]
0x4004 MTIMECMP_HART0_HI reset not defined — Word HI của mtimecmp hart 0; dùng trình tự RV32 an toàn trong BSP. [access=rw]
0x4008 MTIMECMP_HART1_LO reset not defined — Word LO của mtimecmp hart 1; dùng trình tự RV32 an toàn trong BSP. [access=rw]
0x400C MTIMECMP_HART1_HI reset not defined — Word HI của mtimecmp hart 1; dùng trình tự RV32 an toàn trong BSP. [access=rw]
0xBFF8 MTIME_LO ro reset not defined — Bộ đếm chung 64 bit, 20 MHz; đọc HI/LO/HI để tránh rollover. [access=ro]
0xBFFC MTIME_HI ro reset not defined — Bộ đếm chung 64 bit, 20 MHz; đọc HI/LO/HI để tránh rollover. [access=ro]

## PLIC — Theo BSP VP: ID 0 bỏ trống; ID 1..9; context n là hart n M-mode. Không khai nguồn 0 thành IRQ.
Base 0x0C000000
{0x0+4i} PRIORITY_{i} reset not defined (i=1..9) — Priority nguồn PLIC, hợp lệ 0..7; 0 tắt ưu tiên. [access=rw]
  [2:0] PRIORITY — [access=rw]
0x28 PRIORITY_10 reset not defined — Priority nguồn PLIC, hợp lệ 0..7; 0 tắt ưu tiên. Source 10 = đường test 0 của SIM_CTRL (chỉ VP). [access=rw]
  [2:0] PRIORITY — [access=rw]
0x2C PRIORITY_11 reset not defined — Priority nguồn PLIC, hợp lệ 0..7; 0 tắt ưu tiên. Source 11 = đường test 1 của SIM_CTRL (chỉ VP). [access=rw]
  [2:0] PRIORITY — [access=rw]
0x1000 PENDING ro reset not defined — Bit i: pending nguồn i, nguồn 0 không sử dụng. [access=ro]
0x2000 ENABLE_HART0_M reset not defined — Bit i enable nguồn i cho hart 0 M-mode. [access=rw]
0x2080 ENABLE_HART1_M reset not defined — Bit i enable nguồn i cho hart 1 M-mode. [access=rw]
0x200000 THRESHOLD_HART0_M reset not defined — Ngưỡng priority; IRQ phải cao hơn ngưỡng. [access=rw]
  [2:0] THRESHOLD — [access=rw]
0x200004 CLAIM_COMPLETE_HART0_M reset not defined read-modifies — Đọc claim có tác dụng phụ, trả source ID hoặc 0; ghi cùng ID để complete. ACK thiết bị trước complete. [access=rw]
0x201000 THRESHOLD_HART1_M reset not defined — Ngưỡng priority; IRQ phải cao hơn ngưỡng. [access=rw]
  [2:0] THRESHOLD — [access=rw]
0x201004 CLAIM_COMPLETE_HART1_M reset not defined read-modifies — Đọc claim có tác dụng phụ, trả source ID hoặc 0; ghi cùng ID để complete. ACK thiết bị trước complete. [access=rw]
