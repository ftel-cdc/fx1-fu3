# WEACT_F412 register map
Vendor: STMicroelectronics
STM32F412RET6 (WeAct Studio STM32F4 Core Board) - test rig hardware the real user has, NOT FU2 chips. See file header warning.
Registers are 32-bit, read-write, reset 0x0 unless marked. A register's access mark holds for its fields unless they carry their own. Offsets are from the block's base; lines under a group give offsets from that group; [hi:lo] are bit positions; {n}, {i} and the like mark numbered series; 'fields as' and 'values as' point back to an identical list; <NAME> marks a mode.

## Memory map
0x40011000 USART1 size 0x400 — USART1 REAL - used by UART bootloader on PA9(TX)/PA10(RX), AF7, 115200 8N1 (see bootloader.uart below)
0x40020000 GPIOA size 0x400 — GPIOA REAL - pins PA9(TX)/PA10(RX) for UART bootloader (USART1, AF7)
0x40020400 GPIOB size 0x400 — GPIOB REAL - pins PB2=LED onboard of WeAct STM32F4 Core Board
0x40023800 RCC size 0x400 — REAL Reset and Clock Control - AHB1ENR (GPIO) + APB2ENR (USART1, required for UART bootloader)
0x40023C00 FLASH size 0x400 — REAL FLASH controller - used by bootloader to erase/program sector app (see components/driver/flash)

## RCC — REAL Reset and Clock Control - AHB1ENR (GPIO) + APB2ENR (USART1, required for UART bootloader)
Base 0x40023800
0x30 AHB1ENR — AHB1 peripheral clock enable - bit 1=GPIOBEN. other AHBENR (STM32F0, offset 0x14) and IOPENR (STM32L0, offset 0x2C) - validate real RCC_AHB1ENR_GPIOBEN in stm32f412zx.h
0x44 APB2ENR — APB2 peripheral clock enable - bit 4=USART1EN. true - confirm RCC_APB2ENR_USART1EN_Pos=4 in stm32f412zx.h

## GPIOA — GPIOA REAL - pins PA9(TX)/PA10(RX) for UART bootloader (USART1, AF7)
Base 0x40020000
Same registers: GPIOB 0x40020400
0x00 MODER reset 0xFFFFFFFF — Mode: 2 bits/pin (00=input,01=output,10=AF,11=analog). Actual reset values vary for BOOT/debug pins; see RM0402. Use 0xFFFFFFFF (all analog) as a safe placeholder.
0x04 OTYPER — Output type - 1 bit/pin (0=push-pull, 1=open-drain)
0x08 OSPEEDR — Output speed - 2 bit/pin
0x0C PUPDR — Pull-up/pull-down - 2 bit/pin
0x10 IDR ro — Input data - read current pin item, 1 pin per bit
0x14 ODR — Output data: one bit per pin
0x18 BSRR wo — bit set/reset - bit[15:0] write 1 to SET, bit[31:16] write 1 to RESET (atomic)
0x1C LCKR — Configuration lock
0x20 AFRL — Alternate function - pin 0..7
0x24 AFRH — Alternate function - pin 8..15

## USART1 — USART1 REAL - used by UART bootloader on PA9(TX)/PA10(RX), AF7, 115200 8N1 (see bootloader.uart below)
Base 0x40011000
0x00 SR reset 0xC0 — Status: bit5=RXNE, bit6=TC, bit7=TXE. TXE=TC=1 after reset, ready to transmit
0x04 DR — Data register (read = RX, write = TX)
0x08 BRR — Baud rate - e.g. 0x8B for 115200 baud @ HSI 16MHz (OVER8=0)
0x0C CR1 — Control 1 - bit2=RE, bit3=TE, bit13=UE
0x10 CR2 — Control 2 (unused - stop bits/clock)
0x14 CR3 — Control 3 (unused - flow control/DMA)
0x18 GTPR — Guard time + prescaler (unused - IrDA/smartcard)

## FLASH — REAL FLASH controller - used by bootloader to erase/program sector app (see components/driver/flash)
Base 0x40023C00
0x00 ACR — Access control (latency/prefetch/cache) - not used
0x04 KEYR wo — Key register - write KEY1=0x45670123 then KEY2=0xCDEF89AB to open CR department
0x08 OPTKEYR wo — Option key register - unused (no option bytes)
0x0C SR — Status - bit0=EOP, bit16=BSY
0x10 CR reset 0x80000000 — Control - bit0=PG, bit1=SER, bit[6:3]=SNB, bit[9:8]=PSIZE, bit16=STRT, bit31=LOCK (reset THAT = locked)
0x14 OPTCR — Option control - not used
0x18 OPTCR1 — Option control 1 - not used
