# GT32U2086 register map
Vendor: FPTTelecom
GT32U2086 - FPT Telecom GT32U2086 MCU - Core : Cortex-M0 - up to 60MHz - Flash: 512KB instruction Flash + 14 x 512-byte NVR slots - RAM : 128KB contiguous SRAM (data only) | IP | Address range | | ---------- | ------------------------------- | | AES | 0x40000000 - 0x4000FFFF (64 KB) | | QSPI_APB | 0x44000000 - 0x4400FFFF (64 KB) | | SYSCSR | 0x44010000 - 0x4401FFFF (64 KB) | | DMA0 | 0x44020000 - 0x4402FFFF (64 KB) | | RNG | 0x44030000 - 0x4403FFFF (64 KB) | | CRC | 0x44040000 - 0x4404FFFF (64 KB) | | WDT | 0x44050000 - 0x4405FFFF (64 KB) | | TIM0 | 0x44060000 - 0x4406FFFF (64 KB) | | TIM1 | 0x44070000 - 0x4407FFFF (64 KB) | | TIM2 | 0x44080000 - 0x4408FFFF (64 KB) | | TIM3 | 0x44090000 - 0x4409FFFF (64 KB) | | PWM0 | 0x440A0000 - 0x440AFFFF (64 KB) | | PWM1 | 0x440B0000 - 0x440BFFFF (64 KB) | | SPI0 | 0x440C0000 - 0x440CFFFF (64 KB) | | UART0 | 0x440D0000 - 0x440DFFFF (64 KB) | | UART1 | 0x440E0000 - 0x440EFFFF (64 KB) | | GPIOC | 0x440F0000 - 0x440FFFFF (64 KB) | | GPIOD | 0x44100000 - 0x4410FFFF (64 KB) | | GPIOE | 0x44110000 - 0x4411FFFF (64 KB) | | GPIOF | 0x44120000 - 0x4412FFFF (64 KB) | | FLASH_CTRL | 0x50000000 - 0x5000FFFF (64 KB) | | CRM | 0x50010000 - 0x5001FFFF (64 KB) | | DMA1 | 0x50020000 - 0x5002FFFF (64 KB) | | GPIOA | 0x50030000 - 0x5003FFFF (64 KB) | | GPIOB | 0x50040000 - 0x5004FFFF (64 KB) | | UART2 | 0x50050000 - 0x5005FFFF (64 KB) | | UART3 | 0x50060000 - 0x5006FFFF (64 KB) | | UART4 | 0x50070000 - 0x5007FFFF (64 KB) | | I2C0 | 0x50080000 - 0x5008FFFF (
Registers are 32-bit, read-write, reset 0x0 unless marked. A register's access mark holds for its fields unless they carry their own. Offsets are from the block's base; lines under a group give offsets from that group; [hi:lo] are bit positions; {n}, {i} and the like mark numbered series; 'fields as' and 'values as' point back to an identical list; <NAME> marks a mode.

## Memory map
0x40000000 AES size 0x400 — AES-128 - ADVANCED ENCRYPTION STANDARD AES : 0x40000000 - 0x4000FFFF (64 KB) Reference: GT32U2086_AES_Specification_v1.0.pdf
0x44000000 QSPI_APB size 0x400 — QSPI - QUAD SERIAL PERIPHERAL INTERFACE CONTROLLER QSPI_APB : 0x44000000 - 0x4400FFFF (64 KB) Reference: dti_qspi_ug_rev0p0p1.pdf
0x44010000 SYSCSR size 0x400 — SYSCSR - SYSTEM CONTROL AND STATUS REGISTERS SYSCSR : 0x44010000 - 0x4401FFFF (64 KB) Reference: GT32U2086_SYSCSR_v4.xlsx
0x44020000 DMA0 size 0x10F8 — DMA0 - GT32U2086 v8 FTEL DMA, 8 channels with 0x100-byte channel stride.
0x44030000 RNG size 0x400 — RNG - RANDOM NUMBER GENERATOR RNG : 0x44030000 - 0x4403FFFF (64 KB) Reference: dti_trng_ug_rev1p0.pdf
0x44040000 CRC size 0x400 — CRC - CYCLIC REDUNDANCY CHECK CRC : 0x44040000 - 0x4404FFFF (64 KB) Reference: GT32U2086_CRC_Hardware_Specification_v2.0.docx.md
0x44050000 WDT size 0x400 — WDT - WATCHDOG TIMER WDT : 0x44050000 - 0x4405FFFF (64 KB) Reference: dti_wdt_ug_rev1p0 (1).pdf
0x44060000 TIM0 size 0x400 — TIM0 - TIMER TIM0 : 0x44060000 - 0x4406FFFF (64 KB) Reference: dti_timer_ug_rev1p0.pdf
0x44070000 TIM1 size 0x400 — TIM1 - TIMER TIM1 : 0x44070000 - 0x4407FFFF (64 KB) Reference: dti_timer_ug_rev1p0.pdf
0x44080000 TIM2 size 0x400 — TIM2 - TIMER TIM2 : 0x44080000 - 0x4408FFFF (64 KB) Reference: dti_timer_ug_rev1p0.pdf
0x44090000 TIM3 size 0x400 — TIM3 - TIMER TIM3 : 0x44090000 - 0x4409FFFF (64 KB) Reference: dti_timer_ug_rev1p0.pdf
0x440A0000 PWM0 size 0x400 — PWM0 - GT32U2086 v8 DTI two-channel PWM register map.
0x440B0000 PWM1 size 0x400 — PWM1 - GT32U2086 v8 DTI two-channel PWM register map.
0x440C0000 SPI0 size 0x400 — SPI0 - DTI SPI rev1.1, Register Description chapter 9. SPI0 : 0x440C0000 - 0x440CFFFF (64 KB)
0x440D0000 UART0 size 0x400 — UART0 - UNIVERSAL ASYNCHRONOUS RECEIVER TRANSMITTER UART0 : 0x440D0000 - 0x440DFFFF (64 KB)
0x440E0000 UART1 size 0x400 — UART1 - UNIVERSAL ASYNCHRONOUS RECEIVER TRANSMITTER UART1 : 0x440E0000 - 0x440EFFFF (64 KB)
0x440F0000 GPIOC size 0x400 — GPIOC - GENERAL PURPOSE INPUT OUTPUT PORT C GPIOC : 0x440F0000 - 0x440FFFFF (64 KB)
0x44100000 GPIOD size 0x400 — GPIOD - GENERAL PURPOSE INPUT OUTPUT PORT D GPIOD : 0x44100000 - 0x4410FFFF (64 KB)
0x44110000 GPIOE size 0x400 — GPIOE - GT32U2086 v8 GPIO port E.
0x44120000 GPIOF size 0x400 — GPIOF - GT32U2086 v8 GPIO port F.
0x50000000 FLASH_CTRL size 0x400 — FLASH_CTRL - FLASH CONTROLLER FLASH_CTRL : 0x50000000 - 0x5000FFFF (64 KB) Reference: GT32U2086 Common Specification v8 / FLASH controller v1.4
0x50010000 CRM size 0x400 — CRM - GT32U2086 v8 clock and reset module. Offsets follow CSR_CRM_gt32u2086_v2_ea.xlsx as implemented by the VP.
0x50020000 DMA1 size 0x10F8 — DMA1 - GT32U2086 v8 FTEL DMA, 8 channels with 0x100-byte channel stride.
0x50030000 GPIOA size 0x400 — GPIOA - GENERAL PURPOSE INPUT OUTPUT PORT A GPIOA : 0x50030000 - 0x5003FFFF (64 KB)
0x50040000 GPIOB size 0x400 — GPIOB - GENERAL PURPOSE INPUT OUTPUT PORT B GPIOB : 0x50040000 - 0x5004FFFF (64 KB)
0x50050000 UART2 size 0x400 — UART2 - UNIVERSAL ASYNCHRONOUS RECEIVER TRANSMITTER UART2 : 0x50050000 - 0x5005FFFF (64 KB)
0x50060000 UART3 size 0x400 — UART3 - UNIVERSAL ASYNCHRONOUS RECEIVER TRANSMITTER UART3 : 0x50060000 - 0x5006FFFF (64 KB)
0x50070000 UART4 size 0x400 — UART4 - UNIVERSAL ASYNCHRONOUS RECEIVER TRANSMITTER UART4 : 0x50070000 - 0x5007FFFF (64 KB)
0x50080000 I2C0 size 0x400 — I2C0 - INTER INTEGRATED CIRCUIT I2C0 : 0x50080000 - 0x5008FFFF (64 KB) Separate TX/RX DMA controls and latched interrupt status.
0x50090000 SPI1 size 0x400 — SPI1 - SERIAL PERIPHERAL INTERFACE SPI1 : 0x50090000 - 0x5009FFFF (64 KB)
0x500A0000 ADC size 0x400 — ADC - GT32U2086 v8 23-register ADC controller.
0x500B0000 TIM4 size 0x400 — TIM4 - TIMER TIM4 : 0x500B0000 - 0x500BFFFF (64 KB) Reference: dti_timer_ug_rev1p0.pdf
0x500C0000 TIM5 size 0x400 — TIM5 - TIMER TIM5 : 0x500C0000 - 0x500CFFFF (64 KB) Reference: dti_timer_ug_rev1p0.pdf
0x500D0000 TIM6 size 0x400 — TIM6 - TIMER TIM6 : 0x500D0000 - 0x500DFFFF (64 KB) Reference: dti_timer_ug_rev1p0.pdf
0x500E0000 TIM7 size 0x400 — TIM7 - TIMER TIM7 : 0x500E0000 - 0x500EFFFF (64 KB) Reference: dti_timer_ug_rev1p0.pdf
0x500F0000 RTC size 0x400 — RTC - REAL TIME CLOCK RTC : 0x500F0000 - 0x500FFFFF (64 KB) Reference: dti_rtc_ug_rev1p0.pdf
