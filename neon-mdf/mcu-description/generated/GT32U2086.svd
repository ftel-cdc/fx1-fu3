# GT32U2086 register map
Vendor: FPTTelecom
Registers are 32-bit, read-write, reset 0x0 unless marked. A register's access mark holds for its fields unless they carry their own. Offsets are from the block's base; [hi:lo] are bit positions; {n}, {i} and the like mark numbered series.

## AES — AES-128 - ADVANCED ENCRYPTION STANDARD AES : 0x40000000 - 0x4000FFFF (64 KB) Reference: GT32U2086_AES_Specification_v1.0.pdf
Base 0x40000000
0x00 VERSION ro reset 0x1 — AES IP version register
0x04 CTRL — AES control register
0x08 STATUS ro reset 0x1 — AES status register
{0x40+4i} KEY{i} (i=0..3) — AES key bits [{32i+31}:{32i}]
{0x80+4i} IV{i} (i=0..3) — Initial vector bits [{32i+31}:{32i}]
{0xC0+4i} DIN{i} wo (i=0..3) — Input data bits [{32i+31}:{32i}]
{0x100+4i} DOUT{i} ro (i=0..3) — Output data bits [{32i+31}:{32i}]
0x140 CTR0 — Counter bits [31:0] / CFB segment length
{0x140+4i} CTR{i} (i=1..3) — Counter bits [{32i+31}:{32i}]

## QSPI_APB — QSPI - QUAD SERIAL PERIPHERAL INTERFACE CONTROLLER QSPI_APB : 0x44000000 - 0x4400FFFF (64 KB) Reference: dti_qspi_ug_rev0p0p1.pdf
Base 0x44000000
0x00 TX — Transmit register
0x04 CCR reset 0x3A0EC00 — Command configuration register
0x08 DLR — Data length register
0x0C AR — Address register
0x10 ABR — Alternate-byte register
0x14 SSR reset 0x2 — Slave select register
0x18 SMR — Polling status mask register
0x1C SMPR — Polling status match pattern register
0x20 CFG reset 0x1C30 — QSPI configuration register
0x24 CAR — QSPI abort control register
0x28 STT ro — QSPI status register
0x2C IMR — Interrupt mask register
0x30 RISR ro — Raw interrupt status register
0x34 MISR ro — Masked interrupt status register
0x38 ICR wo — Interrupt clear register (W1C)
0x3C FIFO reset 0x301FC07F — FIFO programmed level register
0x40 SCLK — QSPI clock divider register
0x44 TREG0 — Timing register 0
0x48 TREG1 — Timing register 1
0x4C TREG2 reset 0x200000 — Timing register 2
0x50 TREG3 reset 0x1 — Timing register 3
0x54 PHYCFG reset 0x2800 — PHY configuration register
0x58 PHYFCLK — PHY feedback clock control register
0x5C RX ro — Receive register
0x60 PHYSTT ro — PHY status register
0x64 DMACTRL — DMA control register
0x68 DMASTT ro — DMA status register

## RNG — RNG - RANDOM NUMBER GENERATOR RNG : 0x44030000 - 0x4403FFFF (64 KB) Reference: dti_trng_ug_rev1p0.pdf
Base 0x44030000
0x00 REC — Random Engine Control Register bit[0] EN | bit[1] MODE
0x04 TREG reset 0xA — Timing Register bit[9:0] TWARM
0x08 LFSR0 reset 0x3F — LFSR Test Register 0 (6-bit) bit[5:0] LEN
0x0C LFSR1 reset 0x7F — LFSR Test Register 1 (7-bit) bit[6:0] LEN
0x10 LFSR2 reset 0x1FF — LFSR Test Register 2 (9-bit) bit[8:0] LEN
0x14 LFSR3 reset 0x3FF — LFSR Test Register 3 (10-bit) bit[9:0] LEN
0x18 LFSR4 reset 0xFFFFFFFF — LFSR Test Register 4 (32-bit) bit[31:0] LEN
0x1C DAT ro — Random Data Register bit[31:0] RNUM
0x20 VLD ro — Random Data Valid Register bit[0] RNUM
0x24 LFSRSTT ro reset 0x3E — LFSR Test Status Register bit[0] DONE | bit[5:1] ERROR

## CRC — CRC - CYCLIC REDUNDANCY CHECK CRC : 0x44040000 - 0x4404FFFF (64 KB) Reference: GT32U2086_CRC_Hardware_Specification_v2.0.docx.md
Base 0x44040000
0x00 VERSION ro reset 0x10000 — Version register bit[15:0] MINOR | bit[31:16] MAJOR
0x10 CTRL — Control register bit[0] EN | bit[15:8] DATA_LENGTH
0x14 GEN_POLY — Generator Polynomial register bit[7:0] VALUE
0x18 STATUS ro — Status register bit[0] FIFO_FULL | bit[1] FIFO_EMPTY | bit[4] CRC_DONE
0x1C RESULT ro — CRC output value (8-bit) bit[7:0] VALUE
0x20 INT_RAW — Raw interrupt status bit[0] CRC_DONE; W1C
0x24 INT_STA ro — Masked interrupt status bit[0] CRC_DONE
0x28 INT_EN — Interrupt enable bit[0] CRC_DONE
0x2C INT_INJ — Interrupt injection bit[0] CRC_DONE
0x30 DATAIN — Data input FIFO

## WDT — WDT - WATCHDOG TIMER WDT : 0x44050000 - 0x4405FFFF (64 KB) Reference: dti_wdt_ug_rev1p0 (1).pdf
Base 0x44050000
0x00 CR — Control Register bit[0] EN | bit[1] RM | bit[9:2] RPL | bit[10] DEBUG
0x04 TORR — Timeout Range Register bit[31:0] TOP
0x08 CCVR ro — Current Counter Value Register bit[31:0] CNT_VAL
0x0C CRR wo — Counter Restart Register bit[7:0] CNT_RESTART; write 0x76 to restart; PDF labels W1C, header declares WO
0x10 STAT ro — Interrupt Status Register bit[0] ISR
0x14 EOI ro — Interrupt Clear Register bit[0] ICR; read clears interrupt
0x18 CLKS ro — Clock Status Register bit[0] CLK_FAILURE | bit[8:1] ADDR_FAILURE | bit[9] CMD_FAILURE
