# CH32V003F4P6 register map
Vendor: WCH
WCH CH32V003F4P6 - RISC-V QingKe V2A (RV32EC), 16KB Flash/2KB SRAM, TSSOP20 package (GPIOA/C/D only). The first RISC-V dev board of this SDK.
Registers are 32-bit, read-write, reset 0x0 unless marked. A register's access mark holds for its fields unless they carry their own. Offsets are from the block's base; lines under a group give offsets from that group; [hi:lo] are bit positions; {n}, {i} and the like mark numbered series; 'fields as' and 'values as' point back to an identical list; <NAME> marks a mode.

## Memory map
0x40010800 GPIOA size 0x400 — GPIOA (PA1-PA2 on call TSSOP20) - RM cabin 7
0x40011000 GPIOC size 0x400 — GPIOC (PC0-PC7) - RM chapter 7
0x40011400 GPIOD size 0x400 — GPIOD (PD0-PD7, PD1 middle SWIO debug + LED onboard on multiple dev boards) - RM chapter 7
0x40013800 USART1 size 0x400 — USART1 (default mapping TX=PD5,RX=PD6) - RM cage 12
0x40021000 RCC size 0x400 — Reset and Clock Control - RM chapter 3
0x40022000 FLASH size 0x400 — Flash memory controller (FPEC) - RM chapter 16

## RCC — Reset and Clock Control - RM chapter 3
Base 0x40021000
0x00 CTLR reset 0x83 — Clock control register (HSION/HSIRDY/PLLON/...): RM reset 0x0000xx83 includes unknown factory-trim bits xx. Use 0x00 only as a descriptive placeholder for those bits.
0x04 CFGR0 reset 0x20 — Clock configuration register 0 (SW/HPRE/PLLSRC/...) - THAT, RM 3.4.2
0x08 INTR — Clock interrupt register - THAT, RM 3.4.3
0x0C APB2PRSTR — PB2 peripheral reset register - THAT, RM 3.4.4
0x10 APB1PRSTR — PB1 peripheral reset register - THAT, RM 3.4.5
0x14 AHBPCENR reset 0x4 — HB peripheral clock enable register - THAT, RM 3.4.6
0x18 APB2PCENR — PB2 peripheral clock enable register - bit0 AFIOEN, bit2 IOPAEN, bit4 IOPCEN, bit5 IOPDEN (true, RM 3.4.7) - used by NEON_GPIO_ClockEnable()
0x1C APB1PCENR — PB1 peripheral clock enable register - THAT, RM 3.4.8
0x24 RSTSCKR reset 0xC000000 — Control/status register (reset source flags) - THAT, RM 3.4.9

## GPIOA — GPIOA (PA1-PA2 on call TSSOP20) - RM cabin 7
Base 0x40010800
Same registers: GPIOC 0x40011000, GPIOD 0x40011400
0x00 CFGLR reset 0x44444444 — Port configuration register low (CNFy/MODEy 2-bit/pin, y=0-7) - THAT, RM 7.3.1.1
0x08 INDR ro — Port input data register - THAT, RM 7.3.1.2
0x0C OUTDR — Port output data register - THAT, RM 7.3.1.3
0x10 BSHR wo — Port set/reset register (bit y set, bit 16+y reset, atomic) - THAT, RM 7.3.1.4
0x14 BCR wo — Port reset register (bit y = clear, atomic) - THAT, RM 7.3.1.5
0x18 LCKR — Port configuration lock register - THAT, RM 7.3.1.6

## USART1 — USART1 (default mapping TX=PD5,RX=PD6) - RM cage 12
Base 0x40013800
0x00 STATR reset 0xC0 — Status register (TXE=bit7,TC=bit6,RXNE=bit5) - THAT, RM 12.10.1
0x04 DATAR — Data register (DR[8:0]) - THAT, RM 12.10.2
0x08 BRR — Baud rate register (DIV_Mantissa[15:4]/DIV_Fraction[3:0]) - THAT, RM 12.10.3
0x0C CTLR1 — Control register 1 (UE=bit13,TE=bit3,RE=bit2), verified against RM 12.10.4
0x10 CTLR2 — Control register 2 - THAT, RM 12.10.5
0x14 CTLR3 — Control register 3 - THAT, RM 12.10.6
0x18 GPR — Guard time and prescaler register - THAT, RM 12.10.7

## FLASH — Flash memory controller (FPEC) - RM chapter 16
Base 0x40022000
0x00 ACTLR — Control register (LATENCY) - THAT, RM 16.3.1
0x04 KEYR wo — FPEC key register: KEY1=0x45670123 and KEY2=0xCDEF89AB unlock it, verified against RM 16.3.2
0x08 OBKEYR wo — Option bytes key register - THAT, RM 16.3.3
0x0C STATR reset 0x8000 — Status register (BUSY=bit0,EOP=bit5) - THAT, RM 16.3.4
0x10 CTLR reset 0x8080 — Configuration register (PG=bit0,PER=bit1,MER=bit2,STRT=bit6,LOCK=bit7) - THAT, RM 16.3.5
0x14 ADDR wo — Address register (dia only erase/program) - real, RM 16.3.6
0x1C OBR ro — Option byte register - THAT, RM 16.3.7
0x20 WPR ro reset 0xFFFFFFFF — Write protection register - THAT, RM 16.3
0x24 MODEKEYR wo — Extended key register (fast programming) - THAT, RM 16.3
0x28 BOOT_MODEKEYR wo — Unlock BOOT key register - THAT, RM 16.3
