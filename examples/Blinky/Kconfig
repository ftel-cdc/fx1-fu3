## examples/UART_RX_Interrupt/Kconfig
```kconfig
menu "FU2 example configuration"

config FU2_EXAMPLE_FIXED_CLOCK_HZ
    int "Fixed FPGA clock (Hz; 0 uses normal SDK clock setup)"
    range 0 1000000000
    default 10000000
    help
        Must match the actual FPGA clock. Zero retains the SDK SystemInit settings.

config FU2_EXAMPLE_RX_TIMEOUT_POLLS
    int "Console RX polling budget"
    range 1 100000000
    default 10000

endmenu

menu "UART RX Interrupt Configuration"

    config UART_RX_INTERRUPT_RING_BUF_SIZE
        int "UART RX Ring Buffer Size"
        range 1 4096
        default 128
        help
            Size of the internal ring buffer for UART RX interrupt handling.
            Number of byte slots, each stored in an aligned 32-bit word on FU2.
            Any positive size is supported, not only powers of 2.

    config UART_RX_INTERRUPT_TX_TIMEOUT_POLLS
        int "UART TX Timeout Polls"
        range 1 100000000
        default 1000000
        help
            Maximum polling loops allowed when transmitting an echo character over UART.

endmenu
```

## neon-mdf/components/driver/Kconfig
```kconfig
menu "components/driver"

config NEON_MDF_DRIVER_UART
    bool "Compile UART drivers"
    default y
    help
        HAL UART polling, FIFO and interrupt-control notifications in build. GT32U2086: Enable UART while
        compiling printf/vprintf/puts/putchar and syscall hook _write, no separate printf flag is
        required. The console initializes UART0 on the first export. Disabling option will remove
        the UART driver and GT32U2086 console from the build; calling those APIs will report link errors.

config NEON_MDF_DRIVER_I2C
    bool "Compile I2C driver (i2c/neon_i2c_gt32u2086.c)"
    default y
    help
        HAL I2C GT32U2086: master/slave polling and interrupt, address 7/10
        bit, memory-read repeated START, FIFO, SMBus/PEC, DMA request,
        bus-clear, CRM management and self-configuration SDA/SCL. Timing using period number i2c_clk; board
        must have external pull-up resistors on both SDA and SCL.

config NEON_MDF_DRIVER_CRC
    bool "Compile CRC-8 driver (crc/neon_crc_gt32u2086.c)"
    default y
    help
        Includes CRC-8 driver (NEON_CRC_Calculate) - real port from src_gt32u2086/gt32u2086_crc.c. Disabled to reduce
        Flash usage if the app is not in use.

config NEON_MDF_DRIVER_EFUSE
    bool
    default n
    help
        Old sdkconfig compatible symbol; OTP source kept at driver/efuse. GT32U2086 ROM v5 save security policy
        and public key in Flash NVR; use Flash driver's NVR API, not old OTP address.

config NEON_MDF_DRIVER_ADC
    bool "Compile ADC driver (adc/neon_adc_gt32u2086.c)"
    default y
    help
        GT32U2086 ADC: 12-bit sample slots, configuration channel/timing and polling.

config NEON_MDF_DRIVER_DMA
    bool "Compile DMA driver (dma/neon_dma_gt32u2086.c)"
    default y
    help
        GT32U2086 FTEL DMA: 8 channel, command register and 32-bit copy word.

config NEON_MDF_DRIVER_SPI
    bool "Compile SPI driver (spi/neon_spi_gt32u2086.c)"
    default y
    help
        HAL SPI master/slave: polling 8/16/24/32-bit, full-duplex, slave-select, timing, FIFO,
        interrupt-status, clock-failure and DMA communication configuration. Pinmux that board
        configuration before transmission.

config NEON_MDF_DRIVER_PWM
    bool "Compile PWM driver (pwm/neon_pwm_gt32u2086.c)"
    default y
    help
        Report includes two-channel PWM GT32U2086 v8 DTI drivers (NEON_PWM_Init/Start/Stop/SetPeriod/SetPulse),
        following the PWM DTI register map selected by GT32U2086 v8 VP.

config NEON_MDF_DRIVER_TIM
    bool "Compile the TIM driver (tim/neon_tim_gt32u2086.c)"
    default y
    help
        report including full Timer driver for two channels CH0/CH1: configuration counter,
        prescaler/reload, compare, update/preload/one-pulse/center-aligned,
        interrupt/flag and clock-failure status. Bitfield and background logic taken from GT32U2086 LL; public API
        checks parameters and returns NEON_StatusTypeDef.

config NEON_MDF_DRIVER_RTC
    bool "Compile RTC driver (rtc/neon_rtc_gt32u2086.c)"
    default y
    help
        Report includes RTC driver (NEON_RTC_Init/SetTime/GetTime/SetDate/GetDate) - Init/DeInit port real
        from src_gt32u2086/gt32u2086_dti_rtc.c, Set/GetTime/Date write new pairing inline helper BCD real in
        header.

config NEON_MDF_DRIVER_TRNG
    bool "Compile TRNG driver (trng/neon_trng_gt32u2086.c)"
    default y
    help
        Report included driver TRNG (NEON_TRNG_Init/GetRandomNumber) - Init/DeInit port real from
        src_gt32u2086/gt32u2086_dti_trng.c, GetRandomNumber write new pairing inline helper real in header. 3rd
        IP (Dolphin Technology).

config NEON_MDF_DRIVER_AES
    bool "Compile AES driver (aes/neon_aes_gt32u2086.c)"
    default y
    help
        GT32U2086 AES-128: ECB/CBC/CTR, key/IV and polling READY/DONE.

config NEON_MDF_DRIVER_QSPI
    bool "Compile QSPI driver"
    default y
    help
        GT32U2086 QSPI SDR: Single/Dual/Quad command phases, FIFO polling,
        transfer completion, abort and memory-mapped reads.
        Flash erase/program, QE and status commands are supplied by the application.
        Automatic status-polling, DDR and DMA APIs are not implemented.

config NEON_MDF_DRIVER_WDT
    bool "Compile watchdog driver (wdt/neon_wdt_gt32u2086.c)"
    default y
    help
        GT32U2086 watchdog: timeout range, reset/interrupt response, refresh,
        read counter and acknowledge interrupt.

endmenu
```

## neon-mdf/components/ftel_isp/Kconfig
```kconfig
config NEON_MDF_FTEL_ISP
    bool "Build FX1 ISP v1.07 component (FX1 platform only)"
    default n
```

## neon-mdf/components/neon_camera_runtime/Kconfig
```kconfig
config NEON_MDF_CAMERA_RUNTIME
    bool "Build Neon camera runtime session core"
    default n
    help
        Single-owner, OS-independent profile session core. Requires a backend
        implementing neon_isp_session.h; optionally enable the FX1 scalar backend.
        The core alone does not enable CSI, simulation or legacy ISP writes.

if NEON_MDF_CAMERA_RUNTIME

config NEON_MDF_CAMERA_FX1_BACKEND
    bool "Build FX1 MAS v1.07 scalar profile register backend"
    default n
    help
        Linear RAW12 replay, CH0 NV12, WB/DG scalar profiles. Table consumers
        and statistics disabled; no legacy fallback or binary IQ adapter.

config NEON_MDF_CAMERA_LEGACY
    bool "Build deprecated CSI/legacy-register camera compatibility API"
    default n
    select NEON_MDF_DRIVER_CSI
    select NEON_MDF_DRIVER_ISP
    help
        Explicit opt-in for neon_camera_legacy.h. This is not a profile-mode
        backend and must not run alongside a camera profile session.

if NEON_MDF_CAMERA_LEGACY
choice NEON_MDF_CAMERA_SENSOR
    prompt "Reference sensor module"
    default NEON_MDF_CAMERA_SENSOR_IMX675
config NEON_MDF_CAMERA_SENSOR_IMX675
    bool "IMX675"
config NEON_MDF_CAMERA_SENSOR_OS04C10
    bool "OS04C10"
endchoice
endif
endif
```

## neon-mdf/components/neon_net/Kconfig
```kconfig
config NEON_MDF_NET
    bool "Build Neon network manager (lwIP 2.2.1 over neon_eth)"
    default n
    depends on NEON_MDF_DRIVER_ETH
    help
        lwIP TCP/IPv4 stack on FreeRTOS, one Ethernet interface owned by the
        stack's tcpip thread, PHY link tracking, DHCP or static IPv4.
        The application adds it with neon_mdf_add_net() after
        neon_mdf_add_freertos() and uses the lwIP socket/netconn/raw APIs.

if NEON_MDF_NET

config NEON_MDF_NET_TCPIP_PRIORITY
    int "tcpip thread priority"
    default 3
    range 1 31
    help
        FreeRTOS priority of the lwIP tcpip thread. It must be below
        configMAX_PRIORITIES of the application. The thread owns the
        Ethernet driver; tasks above it delay packet processing.

config NEON_MDF_NET_TCPIP_STACK_BYTES
    int "tcpip thread stack (bytes)"
    default 4096
    range 2048 65536

config NEON_MDF_NET_MEM_SIZE
    int "lwIP heap for TX segments and control blocks (bytes)"
    default 32768
    range 8192 1048576

config NEON_MDF_NET_PBUF_POOL_SIZE
    int "RX packet buffers (1516 bytes each)"
    default 24
    range 8 256

config NEON_MDF_NET_TCP_WND_MSS
    int "TCP receive window and send buffer (multiples of 1460-byte MSS)"
    default 4
    range 2 32

config NEON_MDF_NET_DHCP
    bool "DHCP client"
    default y

config NEON_MDF_NET_DNS
    bool "DNS resolver"
    default y

config NEON_MDF_NET_LOOPBACK
    bool "Loop traffic to the interface's own address inside the stack"
    default y
    help
        y: packets to the interface's own IPv4 address never reach the MAC
        (normal on a LAN, where a switch does not return a frame to its
        sender). n: they leave through the MAC and must come back from the
        line, which exercises driver, DMA and PHY on the VP with
        --eth-peer loopback (ARP, ICMP, UDP and TCP to the own address).

config NEON_MDF_NET_LINK_POLL_MS
    int "PHY link poll period (ms)"
    default 500
    range 50 10000

config NEON_MDF_NET_DEBUG
    bool "lwIP assertions report through the console, statistics on"
    default n

endif
```

## neon-mdf/components/neon_tls/Kconfig
```kconfig
config NEON_MDF_TLS
    bool "Build Neon TLS (mbedTLS 3.6.8 LTS over lwIP sockets)"
    default n
    depends on NEON_MDF_NET
    help
        TLS 1.2 client/server sessions over lwIP sockets with software
        crypto. The application adds it with neon_mdf_add_tls() after
        neon_mdf_add_net(). mbedTLS 3.6 LTS is supported until March 2027.

if NEON_MDF_TLS

config NEON_MDF_TLS_MAX_SESSIONS
    int "TLS sessions that can exist at once"
    default 2
    range 1 8
    help
        Static handle pool. Each live session also takes up to about 48 KiB
        of FreeRTOS heap during an ECDHE handshake (16 KiB input record,
        4 KiB output record, handshake state, certificates).

config NEON_MDF_TLS_DEV_ENTROPY
    bool "Development entropy from timer jitter (INSECURE)"
    default y
    help
        FX1 has no documented TRNG yet. This source mixes mtime jitter and
        the MAC address; on the VP it is fully deterministic. It lets TLS run
        for bring-up only: keys and nonces are predictable. Disable it and
        provide neon_tls_port_entropy() from a real TRNG for any product.

endif
```
