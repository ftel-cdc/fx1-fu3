## examples/Blinky/Kconfig
```kconfig
menu "Blinky (this app)"

config BLINKY_DELAY_LOOPS
    int "number of loop delays between each LED toggle"
    default 500000
    help
        Delay busy-loop (no real SysTick/NEON_Delay - see comment in Src/main.c) - value level to LED jump
        CHAM more, decrease to jump FASTer. read through CONFIG_BLINKY_DELAY_LOOPS in Src/main.c.

        Full menuconfig combined: this option is Blinky's own app (not belonging to SDK), appears in the
        same 1 menu as SDK options (components/driver) - see neon-mdf/Kconfig + cmake/kconfig.cmake.

endmenu
```

## examples/FPGA_Terminal/Kconfig
```kconfig
menu "FPGA_Terminal"

config FPGA_TERMINAL_FIXED_CLOCK_HZ
    int "Fixed FPGA clock (Hz; 0 uses normal SDK clock setup)"
    range 0 1000000000
    default 10000000
    help
        must match the actual FPGA clock. Use 0 to retain SDK SystemInit settings.

config FPGA_TERMINAL_LINE_SIZE
    int "Command line buffer size (bytes, including terminator)"
    range 16 512
    default 128

config FPGA_TERMINAL_RX_TIMEOUT_POLLS
    int "RX timeout (poll iterations, not milliseconds)"
    range 1 100000000
    default 10000

rsource "testcase/UART_ECHO_Polling/Kconfig"
rsource "testcase/UART_RX_Interrupt/Kconfig"
rsource "testcase/UART_DMA/Kconfig"
rsource "testcase/PWM_Output/Kconfig"
rsource "testcase/SPI_W5500/Kconfig"

endmenu
```

## examples/FPGA_Terminal/testcase/PWM_Output/Kconfig
```kconfig
menu "PWM Output Testcase Configuration"

    config PWM_OUTPUT_TEST_PERIOD
        int "PWM Period Ticks (Base resolution)"
        default 1000
        help
            Dung luong tick chu ky PWM (vi du: 1000 tương đương 100% resolution).

    config PWM_OUTPUT_TEST_PRESCALER
        int "PWM Clock Prescaler"
        default 15
        help
            He so chia tan clock cho khoi PWM/TIM.

endmenu
```

## examples/FPGA_Terminal/testcase/SPI_W5500/Kconfig
```kconfig
menu "SPI W5500 testcase"

config SPI_W5500_SCK_HZ
    int "Initial SPI0 SCK frequency (Hz)"
    range 1000 5000000
    default 1000000
    help
        Starts in mode 3, MSB first, hardware SS0. The divider is rounded
        up so the actual SCK does not exceed this requested frequency.

config SPI_W5500_TIMEOUT_POLLS
    int "SPI polling budget per transfer"
    range 1000 100000000
    default 1000000
    help
        Polling iterations, not milliseconds; includes the final-frame guard.

config SPI_W5500_B2B_TRIES
    int "Read attempts per B2B sweep level"
    range 10 100000
    default 1000
    help
        Menu key b sweeps byte pauses from 10 down to 0 SCK periods.
        Each attempt reads VERSIONR and the same 32 socket 0 TX SRAM bytes.
        CRC32 must match the reference validated at 10 SCK periods.
        No W5500 registers or SRAM are written by this sweep.

endmenu
```

## examples/FPGA_Terminal/testcase/UART_DMA/Kconfig
```kconfig
menu "UART DMA testcase"

config UART_DMA_TIMEOUT_POLLS
    int "UART DMA polling budget"
    range 1000 100000000
    default 10000000
    help
        Maximum main-loop iterations while waiting for a DMA transfer.
        This is not a time in milliseconds. Paste the RX pattern after READY.

endmenu
```

## examples/FPGA_Terminal/testcase/UART_ECHO_Polling/Kconfig
```kconfig
menu "UART_ECHO_Polling testcase"

config UART_ECHO_RX_TIMEOUT_POLLS
    int "Echo RX timeout (poll iterations, not milliseconds)"
    range 1 100000000
    default 10000
    help
        Polling budget for receiving one byte. A timeout with no buffered data is normal
        and continue to receive.

config UART_ECHO_TX_TIMEOUT_POLLS
    int "Echo TX timeout (poll iterations, not milliseconds)"
    range 1 100000000
    default 1000000
    help
        Budget poll for one time Transmit a byte echo. When error, testcase write receives and continues to
        receive, not from regui the byte. Baud and clock share the configuration of FPGA_Terminal.

endmenu
```

## examples/FreeRTOS_Peripheral_Queue/Kconfig
```kconfig
menu "FU2 example configuration"

config FU2_EXAMPLE_FIXED_CLOCK_HZ
    int "Fixed FPGA clock (Hz; 0 uses normal SDK clock setup)"
    range 0 1000000000
    default 10000000
    help
        Must match the actual FPGA clock. Zero retains the SDK SystemInit settings.

config FREERTOS_PERIPHERAL_QUEUE_LENGTH
    int "Number of events in the shared queue"
    range 1 128
    default 16
    help
        UART RX interrupts and the periodic task share this queue.
        New events are dropped and counted when the queue is full.

config FREERTOS_PERIPHERAL_QUEUE_PERIOD_MS
    int "Periodic event interval (ms)"
    range 100 60000
    default 1000

endmenu
```

## examples/I2C_DMA/Kconfig
```kconfig
menu "GT32U2086 example configuration"

config GT32U2086_EXAMPLE_FIXED_CLOCK_HZ
    int "Fixed FPGA clock (Hz; 0 uses normal SDK clock setup)"
    range 0 1000000000
    default 10000000
    help
        Must match the actual FPGA clock. Zero retains the SDK SystemInit settings.

config GT32U2086_EXAMPLE_RX_TIMEOUT_POLLS
    int "Console RX polling budget"
    range 1 100000000
    default 10000

endmenu

menu "I2C DMA example"

config I2C_DMA_ADDRESS
    hex "AT24C256 7-bit device address"
    range 0x50 0x57
    default 0x57

config I2C_DMA_TIMEOUT_POLLS
    int "Polling budget per I2C/DMA transfer"
    range 1000 100000000
    default 1000000
    help
        Polling iterations, not milliseconds. Used for transfer completion
        and STOP cleanup. An incomplete DMA command requires an FPGA reset.

endmenu
```

## examples/I2C_EEPROM/Kconfig
```kconfig
menu "FU2 example configuration"

config FU2_EXAMPLE_FIXED_CLOCK_HZ
    int "Fixed FPGA clock (Hz; 0 uses normal SDK clock setup)"
    range 0 1000000000
    default 10000000
    help
        Must match the actual FPGA clock. Zero retains the SDK SystemInit settings.

config FU2_EXAMPLE_RX_TIMEOUT_POLLS
    int "Console RX polling budget"
    range 1 100000000
    default 10000

endmenu

menu "I2C EEPROM example"

config I2C_EEPROM_ADDRESS
    hex "AT24C256 7-bit device address"
    range 0x50 0x57
    default 0x57

config I2C_EEPROM_TIMEOUT_POLLS
    int "Polling budget per I2C transfer or EEPROM delay"
    range 1000 100000000
    default 1000000
    help
        Polling iterations, not milliseconds. A 6 ms EEPROM write delay
        uses the core-clock SysTick counter.

endmenu
```

## examples/PWM_Output/Kconfig
```kconfig
menu "GT32U2086 example configuration"

config GT32U2086_EXAMPLE_FIXED_CLOCK_HZ
    int "Fixed FPGA clock (Hz; 0 uses normal SDK clock setup)"
    range 0 1000000000
    default 10000000
    help
        Must match the actual FPGA clock. Zero retains the SDK SystemInit settings.

config GT32U2086_EXAMPLE_RX_TIMEOUT_POLLS
    int "Console RX polling budget"
    range 1 100000000
    default 10000

endmenu

menu "PWM Output Example Configuration"

    config PWM_OUTPUT_TEST_PERIOD
        int "PWM Period Ticks (Base resolution)"
        default 1000
        help
            use the amount of PWM period ticks (full text: 1000 equivalent to 100% resolution).

    config PWM_OUTPUT_TEST_PRESCALER
        int "PWM Clock Prescaler"
        default 15
        help
            PWM/TIM block clock prescaler.

endmenu
```

## examples/QSPI_Flash_Read_Write/Kconfig
```kconfig
menu "FU2 example configuration"

config FU2_EXAMPLE_FIXED_CLOCK_HZ
    int "Fixed FPGA clock (Hz; 0 uses normal SDK clock setup)"
    range 0 60000000
    default 10000000
    help
        Must match the actual FPGA clock. Zero retains the SDK SystemInit settings.

endmenu

menu "QSPI_Flash_Read_Write configuration"

config QSPI_FLASH_READ_WRITE_TEST_OFFSET
    hex "Reserved NOR test sector offset (4 KiB aligned)"
    range 0x1000 0x3F000
    default 0x3C000
    help
        All write tests erase this entire 4096-byte sector without restoring it.
        Reserve it exclusively for this example, outside existing firmware/data.
        An unaligned offset is rejected at compile time.

config QSPI_FLASH_READ_WRITE_DIVIDER
    int "QSPI divider encoding (0=/2, 1=/4, ..., 7=/256)"
    range 0 7
    default 4
    help
        Test SCK is input_clock / 2^(encoding+1). Wake/reset always uses /32.

choice QSPI_FLASH_READ_WRITE_CLOCK_MODE
    prompt "QSPI SDR clock mode"
    default QSPI_FLASH_READ_WRITE_MODE_0

config QSPI_FLASH_READ_WRITE_MODE_0
    bool "Mode 0 (CPOL=0, CPHA=0)"

config QSPI_FLASH_READ_WRITE_MODE_3
    bool "Mode 3 (CPOL=1, CPHA=1)"

endchoice

config QSPI_FLASH_READ_WRITE_TIMEOUT_POLLS
    int "QSPI transfer/abort polling budget"
    range 1000 100000000
    default 100000

config QSPI_FLASH_READ_WRITE_READY_POLLS
    int "Maximum NOR status/write-enable commands per wait"
    range 1000 10000000
    default 1000000
    help
        Poll counts are not milliseconds. At higher SCK, allow enough status
        commands for the NOR's maximum sector-erase/program time.

endmenu
```

## examples/QSPI_XIP_Read/Kconfig
```kconfig
menu "FU2 example configuration"

config FU2_EXAMPLE_FIXED_CLOCK_HZ
    int "Fixed FPGA clock (Hz; 0 uses normal SDK clock setup)"
    range 0 60000000
    default 10000000
    help
        Must match the actual FPGA clock. Zero retains the SDK SystemInit settings.

endmenu

menu "QSPI_XIP_Read configuration"

config QSPI_XIP_READ_TEST_OFFSET
    hex "Reserved NOR test sector offset (4 KiB aligned)"
    range 0x1000 0x3F000
    default 0x3C000
    help
        All write tests erase this entire 4096-byte sector without restoring it.
        Reserve it exclusively for this example, outside existing firmware/data.
        An unaligned offset is rejected at compile time.

config QSPI_XIP_READ_DIVIDER
    int "QSPI divider encoding (0=/2, 1=/4, ..., 7=/256)"
    range 0 7
    default 4
    help
        Test SCK is input_clock / 2^(encoding+1). Wake/reset always uses /32.

choice QSPI_XIP_READ_CLOCK_MODE
    prompt "QSPI SDR clock mode"
    default QSPI_XIP_READ_MODE_0

config QSPI_XIP_READ_MODE_0
    bool "Mode 0 (CPOL=0, CPHA=0)"

config QSPI_XIP_READ_MODE_3
    bool "Mode 3 (CPOL=1, CPHA=1)"

endchoice

config QSPI_XIP_READ_TIMEOUT_POLLS
    int "QSPI transfer/abort polling budget"
    range 1000 100000000
    default 100000

config QSPI_XIP_READ_READY_POLLS
    int "Maximum NOR status/write-enable commands per wait"
    range 1000 10000000
    default 1000000
    help
        Poll counts are not milliseconds. At higher SCK, allow enough status
        commands for the NOR's maximum sector-erase/program time.

config QSPI_XIP_READ_TRIES
    int "Captures in the repeated XIP read test"
    range 1 1000000
    default 100

endmenu
```

## examples/RTC_Calendar/Kconfig
```kconfig
menu "GT32U2086 example configuration"

config GT32U2086_EXAMPLE_FIXED_CLOCK_HZ
    int "Fixed FPGA clock (Hz; 0 uses normal SDK clock setup)"
    range 0 1000000000
    default 10000000
    help
        Must match the actual FPGA clock. Zero retains the SDK SystemInit settings.

config GT32U2086_EXAMPLE_RX_TIMEOUT_POLLS
    int "Console RX polling budget"
    range 1 100000000
    default 10000

endmenu

menu "RTC calendar"

config RTC_CALENDAR_PRESCALER
    int "RTC source divider (source Hz / 100)"
    range 1 67108863
    default 360
    help
        Match the actual RTC source. The reference configuration uses 360;
        verify second timing on the board rather than inferring it from SystemCoreClock.

endmenu
```

## examples/SPI_DMA/Kconfig
```kconfig
menu "FU2 example configuration"

config FU2_EXAMPLE_FIXED_CLOCK_HZ
    int "Fixed FPGA clock (Hz; 0 uses normal SDK clock setup)"
    range 0 1000000000
    default 10000000
    help
        Must match the actual FPGA clock. Zero retains the SDK SystemInit settings.

config FU2_EXAMPLE_RX_TIMEOUT_POLLS
    int "Console RX polling budget"
    range 1 100000000
    default 10000

endmenu

menu "SPI DMA example"

config SPI_DMA_SCK_HZ
    int "SPI0 SCK frequency (Hz)"
    range 10000 5000000
    default 1000000
    help
        Mode 3, MSB first, hardware SS0, 32-bit payloads. The divider rounds
        down the actual frequency so it does not exceed the requested value.

config SPI_DMA_TIMEOUT_POLLS
    int "SPI/DMA polling budget"
    range 1000 100000000
    default 1000000
    help
        Polling iterations, not milliseconds. A DMA command that does not
        finish requires resetting the FPGA before another run.

endmenu
```

## examples/SPI_W5500/Kconfig
```kconfig
rsource "../cmake/FPGA_Kconfig"

menu "SPI W5500 example"

config SPI_W5500_SCK_HZ
    int "Initial SPI0 SCK frequency (Hz)"
    range 1000 5000000
    default 1000000
    help
        Starts in mode 3, MSB first, hardware SS0. The divider is rounded
        up so the actual SCK does not exceed this requested frequency.

config SPI_W5500_TIMEOUT_POLLS
    int "SPI polling budget per transfer"
    range 1000 100000000
    default 1000000
    help
        Polling iterations, not milliseconds; includes the final-frame guard.

config SPI_W5500_B2B_TRIES
    int "Read attempts per B2B gap and mode/speed case"
    range 10 100000
    default 1000
    help
        Menu key b tests modes 0 and 3 at requested SCK 1/3/5/10 MHz.
        Frequencies the divider cannot generate exactly are skipped.
        Each case sweeps byte pauses from 10 down to 0 SCK periods.
        Each attempt reads VERSIONR and the same 32 socket 0 TX SRAM bytes.
        All cases use the same CRC32 reference, first validated in mode 0
        at 1 MHz with a 10-SCK pause. An unstable first baseline stops the
        whole sweep; other cases failing at gap 10 skip their lower gaps.
        No W5500 registers or SRAM are written by this sweep.

endmenu
```

## examples/UART_DMA/Kconfig
```kconfig
menu "FU2 example configuration"

config FU2_EXAMPLE_FIXED_CLOCK_HZ
    int "Fixed FPGA clock (Hz; 0 uses normal SDK clock setup)"
    range 0 1000000000
    default 10000000
    help
        Must match the actual FPGA clock. Zero retains the SDK SystemInit settings.

config FU2_EXAMPLE_RX_TIMEOUT_POLLS
    int "Console RX polling budget"
    range 1 100000000
    default 10000

endmenu

menu "UART DMA example"

config UART_DMA_TIMEOUT_POLLS
    int "UART DMA polling budget"
    range 1000 100000000
    default 10000000
    help
        Maximum main-loop iterations while waiting for a DMA transfer.
        This is not a time in milliseconds. Paste the RX pattern after READY.

endmenu
```

## examples/UART_ECHO_Polling/Kconfig
```kconfig
menu "GT32U2086 example configuration"

config GT32U2086_EXAMPLE_FIXED_CLOCK_HZ
    int "Fixed FPGA clock (Hz; 0 uses normal SDK clock setup)"
    range 0 1000000000
    default 10000000
    help
        Must match the actual FPGA clock. Zero retains the SDK SystemInit settings.

config GT32U2086_EXAMPLE_RX_TIMEOUT_POLLS
    int "Console RX polling budget"
    range 1 100000000
    default 10000

endmenu

menu "UART_ECHO_Polling example"

config UART_ECHO_RX_TIMEOUT_POLLS
    int "Echo RX timeout (poll iterations, not milliseconds)"
    range 1 100000000
    default 10000
    help
        Polling budget for receiving one byte. A timeout with no buffered data is normal
        and continue to receive.

config UART_ECHO_TX_TIMEOUT_POLLS
    int "Echo TX timeout (poll iterations, not milliseconds)"
    range 1 100000000
    default 1000000
    help
        Budget poll for one time Transmit a byte echo. When error, example write receives and continues to
        receive, not from regui the byte. UART0 is initialized by the console; the FPGA clock is configured above.

endmenu
```
